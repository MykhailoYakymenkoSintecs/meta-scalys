## conf/distro/scalys.conf
```bitbake
require conf/distro/poky.conf

DISTRO = "scalys"
DISTRO_NAME = "Scalys base distro"
DISTRO_VERSION = "1.0"

# Log information on images and packages
INHERIT += "buildhistory"
BUILDHISTORY_COMMIT ?= "1"

INIT_MANAGER = "systemd"

DISTRO_FEATURES:append = "seccomp virtualization security tpm2 ipv6 wifi bluetooth usbhost pci"

PACKAGE_CLASSES = "package_rpm"
```

## conf/machine/trustbox-edge-101.conf
```bitbake
#@TYPE: Machine
#@NAME: Scalys TrustBox Edge 101
#@SOC: LSCH2
#@DESCRIPTION: Machine configuration for running TBE101
#@MAINTAINER: <opensource@scalys.com>

MACHINEOVERRIDES =. "fsl-lsch2:ls1012a:"

require conf/machine/include/qoriq-arm64.inc
require conf/machine/include/arm/arch-arm64.inc

MACHINE_FEATURES += "optee"
MACHINE_FEATURES += "wifi usbhost bluetooth pci"

KERNEL_CLASSES  = " kernel-fitimage "
KERNEL_IMAGETYPES = "fitImage"

KERNEL_MODULE_AUTOLOAD += "rtl8723bu"
MACHINE_EXTRA_RRECOMMENDS += "kernel-module-8723bu kernel-firmware-rtl8723bu-nic kernel-firmware-rtl8723bu-bt"

UBOOT_DTB_LOADADDRESS = "0x90000000"
UBOOT_ENTRYPOINT = "0x80080000"

UBOOT_CONFIG ??= "tfa-secure-boot tfa"
UBOOT_CONFIG[tfa] = "tbe101_tfa_defconfig,,u-boot-dtb.bin"
UBOOT_CONFIG[tfa-secure-boot] = "tbe101_tfa_SECURE_BOOT_defconfig,,u-boot-dtb.bin"

RCWQSPI ?= "N_SSNH_3308/rcw_1000"
RCWQSPISEC ?= "N_SSNH_3308/rcw_1000"

KERNEL_DEVICETREE ?= "freescale/scalys-tbe101.dtb"
KERNEL_DEFCONFIG ?= "defconfig"

EXTRA_IMAGEDEPENDS += "ppfe-firmware rcw qoriq-atf"
USE_VT = "0"

MACHINE_EXTRA_RRECOMMENDS += "ppfe-firmware kernel-module-8723bu"
```

## conf/machine/trustbox-edge-201.conf
```bitbake
#@TYPE: Machine
#@NAME: Scalys TBE201
#@SOC: LSCH3
#@DESCRIPTION: Machine configuration for running TBE201
#@MAINTAINER: <opensource@scalys.com>

MACHINEOVERRIDES =. "fsl-lsch3:ls1028a:"

require conf/machine/include/qoriq-arm64.inc
require conf/machine/include/arm/arch-arm64.inc

MACHINE_FEATURES += "optee"
MACHINE_FEATURES += "usbhost pci"

WKS_FILES = "trustbox-edge-201.wks.in"

KERNEL_CLASSES  = " kernel-fitimage "
KERNEL_IMAGETYPES = "fitImage"

UBOOT_DTB_LOADADDRESS = "0x90000000"
UBOOT_ENTRYPOINT = "0x80080000"

UBOOT_CONFIG ??= "tfa-secure-boot tfa"
UBOOT_CONFIG[tfa-secure-boot] = "tbe201_tfa_SECURE_BOOT_defconfig"
UBOOT_CONFIG[tfa] = "tbe201_tfa_defconfig"

KERNEL_DEVICETREE ?= "freescale/scalys-tbe201.dtb"
KERNEL_DEFCONFIG ?= "defconfig"

SERIAL_CONSOLES ?= "115200;ttyS0 115200;ttyS1 115200;ttyAMA0"
SERIAL_CONSOLES_CHECK ?= "${SERIAL_CONSOLES}"

RCWSD ?= "N_SQPP_0x85be/rcw_1500"

EXTRA_IMAGEDEPENDS += "rcw qoriq-atf dp-firmware-cadence"
USE_VT = "0"
```

## conf/machine/trustbox-edge-401.conf
```bitbake
#@TYPE: Machine
#@NAME: TrustBox Edge 401
#@SOC: LSCH2
#@DESCRIPTION: Machine configuration for Trustbox Edge 401
#@MAINTAINER: <opensource@scalys.com>

MACHINEOVERRIDES =. "fsl-lsch2:ls1046a:"

require conf/machine/include/qoriq-arm64.inc
require conf/machine/include/arm/arch-arm64.inc

MACHINE_FEATURES += "optee"
MACHINE_FEATURES += "wifi usbhost bluetooth pci"

WKS_FILES = "trustbox-edge-401.wks.in"

KERNEL_CLASSES  = " kernel-fitimage "
KERNEL_IMAGETYPES = "fitImage"

UBOOT_DTB_LOADADDRESS = "0x90000000"
UBOOT_ENTRYPOINT = "0x80080000"

UBOOT_CONFIG ??= "tfa-secure-boot tfa"
UBOOT_CONFIG[tfa] = "tbe401_tfa_defconfig"
UBOOT_CONFIG[tfa-secure-boot] = "tbe401_tfa_SECURE_BOOT_defconfig"

KERNEL_DEVICETREE ?= "\
    freescale/scalys-tbe401.dtb \
"

KERNEL_DEFCONFIG ?= "defconfig"

SERIAL_CONSOLES ?= "115200;ttyS0 115200;ttyAMA0 115200;ttyLP0"
SERIAL_CONSOLES_CHECK ?= "${SERIAL_CONSOLES}"

RCWQSPI ?= "NN_NNQNNPNP_3040_0506/rcw_1600_qspiboot"
RCWSD ?= "NN_NNQNNPNP_3040_0506/rcw_1600_sdboot"

FMAN_UCODE ?= "fsl_fman_ucode_ls1046_r1.0_106_4_18.bin"

EXTRA_IMAGEDEPENDS += "fm-ucode rcw qoriq-atf ls2-phy qe-ucode"
USE_VT = "0"
```
